# RA register map
Vendor: Renesas; Series: All Chips; File version: x.xx
Renesas RA All MCU
Registers are 32-bit, read-write, reset 0x0 unless marked. A register's access mark holds for its fields unless they carry their own. Offsets are from the block's base; lines under a group give offsets from that group; [hi:lo] are bit positions; {n}, {i} and the like mark numbered series; 'fields as' and 'values as' point back to an identical list; <NAME> marks a mode.

## Memory map
0x40000000 R_MPU_MMPU blocks up to offset 0xBFC — Bus Master MPU
0x40000C00 R_MPU_SMPU blocks up to offset 0x36 — Bus Slave MPU
0x40000D00 R_MPU_SPMON blocks up to offset 0x20 — CPU Stack Pointer Monitor
0x40000E00 R_TZF blocks up to offset 0x184 — TrustZone Filter
0x40001000 R_MMF size 0x8 — Memory Mirror Function
0x40002000 R_SRAM blocks up to offset 0xD9 — SRAM
0x40003000 R_BUS blocks up to offset 0x18A5 — Bus Interface
0x40005000 R_DMAC0 blocks up to offset 0x1F — DMA Controller
0x40005040 R_DMAC1 blocks up to offset 0x1F
0x40005080 R_DMAC2 blocks up to offset 0x1F
0x400050C0 R_DMAC3 blocks up to offset 0x1F
0x40005100 R_DMAC4 blocks up to offset 0x1F
0x40005140 R_DMAC5 blocks up to offset 0x1F
0x40005180 R_DMAC6 blocks up to offset 0x1F
0x400051C0 R_DMAC7 blocks up to offset 0x1F
0x40005200 R_DMA size 0x1 — DMA Controller Common
0x40005400 R_DTC blocks up to offset 0x10 — Data Transfer Controller
0x40006000 R_ICU blocks up to offset 0x480 — Interrupt Controller Unit
0x40007000 R_CACHE blocks up to offset 0x208
0x40008000 R_CPSCU blocks up to offset 0x1B4 — CPU System Security Control Unit
0x4001B000 R_DEBUG blocks up to offset 0x14 — Debug Function
0x4001C000 R_FCACHE blocks up to offset 0x11D — Flash Memory Cache
0x4001E000 R_SYSTEM blocks up to offset 0x700 — System Pins
0x40040000 R_PORT0 size 0x10 — I/O Ports
{0x40040000+0x20*n} R_PORT{n} size 0x10 (n=1..11)
0x40040800 R_PFS size 0x40 — I/O Ports-PFS
0x40040D00 R_PMISC blocks up to offset 0x4 — I/O Ports-MISC
0x40041000 R_ELC blocks up to offset 0x6A — Event Link Controller
0x40042000 R_GPT_POEG0 size 0x4 — Port Output Enable for GPT
0x40042100 R_GPT_POEG1 size 0x4
0x40042200 R_GPT_POEG2 size 0x4
0x40042300 R_GPT_POEG3 size 0x4
0x40044000 R_RTC blocks up to offset 0x7D — Realtime Clock
0x40044200 R_WDT blocks up to offset 0x9 — Watchdog Timer
0x40044400 R_IWDT blocks up to offset 0x6 — Independent Watchdog Timer
0x40044600 R_CAC blocks up to offset 0xC — Clock Frequency Accuracy Measurement Circuit
0x40047000 R_MSTP size 0xC — System-Module Stop
0x40048000 R_SRC blocks up to offset 0x6000 — Sampling Rate Converter
0x4004E000 R_SSI0 blocks up to offset 0x28 — Serial Sound Interface Enhanced (SSIE)
0x4004E100 R_SSI1 blocks up to offset 0x28 — Serial Sound Interface Enhanced (SSIE)
0x40050000 R_CAN0 blocks up to offset 0x859 — Controller Area Network (CAN) Module
0x40051000 R_CAN1 blocks up to offset 0x859
0x40053000 R_IIC0 blocks up to offset 0x18 — I2C Bus Interface
0x40053100 R_IIC1 blocks up to offset 0x18
0x40053200 R_IIC2 blocks up to offset 0x18
0x40054100 R_DOC blocks up to offset 0x6 — Data Operation Circuit
0x4005C000 R_ADC0 blocks up to offset 0x1B2 — A/D Converter
0x4005C200 R_ADC1 blocks up to offset 0x1B2
0x4005D000 R_TSN_CTRL size 0x1 — Temperature Sensor
0x4005E000 R_DAC size 0xA — D/A Converter
0x40060000 R_USB_HS0 blocks up to offset 0x408
0x40062000 R_SDHI0 blocks up to offset 0x1E4 — SD/MMC Host Interface
0x40062400 R_SDHI1 blocks up to offset 0x1E4
0x40064000 R_ETHERC_EDMAC blocks up to offset 0xDC — Ethernet DMA Controller
0x40064100 R_ETHERC0 blocks up to offset 0xFC — Ethernet MAC Controller
0x40064500 R_ETHERC_EPTPC_CFG size 0xC — Ethernet PTP Configuration
0x40065000 R_ETHERC_EPTPC_COMMON blocks up to offset 0x438 — Ethernet PTP Controller Common
0x40065800 R_ETHERC_EPTPC blocks up to offset 0x1D8 — Ethernet PTP Controller
0x40065C00 R_ETHERC_EPTPC1 blocks up to offset 0x1D8
0x40070000 R_SCI0 size 0x1D — Serial Communications Interface
{0x40070000+0x20*n} R_SCI{n} size 0x1D (n=1..9)
0x40070F00 R_IRDA size 0x1 — IrDA Interface
0x40072000 R_SPI0 blocks up to offset 0x12 — Serial Peripheral Interface
0x40072100 R_SPI1 blocks up to offset 0x12
0x40074000 R_CRC blocks up to offset 0xE — Cyclic Redundancy Check (CRC) Calculator
0x40078000 R_GPT0 size 0xA4 — General PWM Timer
{0x40078000+0x100*n} R_GPT{n} size 0xA4 (n=1..13)
0x40078FF0 R_GPT_OPS size 0x4 — Output Phase Switching for GPT
0x4007B000 R_GPT_ODC blocks up to offset 0x38 — PWM Delay Generation Circuit
0x40080000 R_KINT blocks up to offset 0x9 — Key Interrupt Function
0x40081000 R_CTSU size 0x1E — Capacitive Touch Sensing Unit
0x40082000 R_CTSU2 blocks up to offset 0x38 — Capacitive Touch Sensing Unit
0x40082000 R_SLCDC blocks up to offset 0x126 — Segment LCD Controller/Driver
0x40083000 I3C blocks up to offset 0x3D4 — I3C Bus Interface
0x40084000 R_AGT0 blocks up to offset 0x10 — Asynchronous General Purpose Timer
0x40084100 R_AGT1 blocks up to offset 0x10
0x40085000 R_ACMPHS0 blocks up to offset 0x11 — High-Speed Analog Comparator
0x40085100 R_ACMPHS1 blocks up to offset 0x11
0x40085200 R_ACMPHS2 blocks up to offset 0x11
0x40085300 R_ACMPHS3 blocks up to offset 0x11
0x40085400 R_ACMPHS4 blocks up to offset 0x11
0x40085500 R_ACMPHS5 blocks up to offset 0x11
0x40085E00 R_ACMPLP blocks up to offset 0x6 — Low-Power Analog Comparator
0x40086000 R_OPAMP blocks up to offset 0x26 — Operational Amplifier
0x4008F000 R_DALI0 blocks up to offset 0x3E — Digital Addressable Lighting Interface
0x40090000 R_USB_FS0 blocks up to offset 0x408 — USB 2.0 Module
0x40094000 R_PDC size 0x1C — Parallel Data Capture Unit
0x4009C000 R_SDADC0 blocks up to offset 0x3D
0x4009E000 R_DAC8 blocks up to offset 0x8 — 8-Bit D/A Converter
0x400A6000 R_OSPI blocks up to offset 0x84 — Octa Serial Peripheral Interface
0x400B0000 R_CANFD blocks up to offset 0x12000 — Controller Area Network - Flexible Data (CAN-FD) Module
0x400E0000 R_PSCU blocks up to offset 0x30 — Peripheral Security Control Unit
0x400E0000 R_GLCDC blocks up to offset 0x1454 — Graphics LCD Controller
0x400E4000 R_DRW blocks up to offset 0xEC — 2D Drawing Engine
0x400E6000 R_JPEG blocks up to offset 0x3D2 — JPEG Codec
0x407E0000 R_FACI_HP_CMD size 0x4 — Flash Application Command Interface Command-Issuing Area
0x407EC000 R_FACI_LP size 0x400 — Flash Application Command Interface
0x407EC000 R_CTSUTRIM size 0x400 — CTSU Trimming Registers
0x407EC000 R_TSN blocks up to offset 0x22A — Temperature Sensor
0x407FB17C R_TSN_CAL size 0x4 — Temperature Sensor
0x407FE000 R_FACI_HP size 0x100 — Flash Application Command Interface
0x64000000 R_QSPI blocks up to offset 0x808 — Quad Serial Peripheral Interface
